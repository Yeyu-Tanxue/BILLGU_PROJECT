## projects/aiot-hearing-terminal/esp32_firmware/capture_for_lstm/sdkconfig.defaults
```kconfig
# ============================================================
# 安信可 ESP32-S3-CAM (ESP32-S3-WROOM-1-N16R8)
# 复用 camera_test 验证过的配置，只升 UART 波特率
# ============================================================

CONFIG_IDF_TARGET="esp32s3"

# ---- Flash ----
CONFIG_ESPTOOLPY_FLASHSIZE_16MB=y
CONFIG_ESPTOOLPY_FLASHMODE_QIO=y
CONFIG_ESPTOOLPY_FLASHFREQ_80M=y

# ---- PSRAM Octal 8MB ----
CONFIG_SPIRAM=y
CONFIG_SPIRAM_MODE_OCT=y
CONFIG_SPIRAM_SPEED_80M=y
CONFIG_SPIRAM_BOOT_INIT=y
CONFIG_SPIRAM_USE_MALLOC=y
CONFIG_SPIRAM_MALLOC_ALWAYSINTERNAL=16384
CONFIG_SPIRAM_TRY_ALLOCATE_WIFI_LWIP=y

# ---- CPU ----
CONFIG_ESP_DEFAULT_CPU_FREQ_MHZ_240=y

# ---- 控制台：UART0 (CH340/COM7)，921600 提速（base64 一组 30s→~4s）----
CONFIG_ESP_CONSOLE_UART_DEFAULT=y
CONFIG_ESP_CONSOLE_UART_BAUDRATE=921600

# ---- 加大 stdout 写缓冲，避免 base64 大块 printf 阻塞 ----
CONFIG_NEWLIB_STDOUT_LINE_ENDING_LF=y
CONFIG_LOG_DEFAULT_LEVEL_INFO=y
```

## projects/aiot-hearing-terminal/esp32_firmware/gesture_cam/sdkconfig.defaults
```kconfig
# ============================================================
# 安信可 ESP32-S3-CAM (ESP32-S3-WROOM-1-N16R8)
# 复用 capture_for_lstm 验证过的配置
# ============================================================
CONFIG_IDF_TARGET="esp32s3"

# Flash
CONFIG_ESPTOOLPY_FLASHSIZE_16MB=y
CONFIG_ESPTOOLPY_FLASHMODE_QIO=y
CONFIG_ESPTOOLPY_FLASHFREQ_80M=y

# PSRAM Octal 8MB
CONFIG_SPIRAM=y
CONFIG_SPIRAM_MODE_OCT=y
CONFIG_SPIRAM_SPEED_80M=y
CONFIG_SPIRAM_BOOT_INIT=y
CONFIG_SPIRAM_USE_MALLOC=y
CONFIG_SPIRAM_MALLOC_ALWAYSINTERNAL=16384
CONFIG_SPIRAM_TRY_ALLOCATE_WIFI_LWIP=y

# CPU
CONFIG_ESP_DEFAULT_CPU_FREQ_MHZ_240=y

# 控制台 UART0 (波特率运行时用 uart_set_baudrate 强制 921600)
CONFIG_ESP_CONSOLE_UART_DEFAULT=y
CONFIG_ESP_CONSOLE_UART_BAUDRATE=115200
```
